## CMakeLists.txt
```
# Smoke-test app for the emulators in the images. See test/emu-smoke.sh.
cmake_minimum_required(VERSION 3.20.0)

find_package(Zephyr REQUIRED HINTS $ENV{ZEPHYR_BASE})
project(emu_smoke)

target_sources(app PRIVATE src/main.c)
```

## prj.conf
```kconfig
# The shell gives renode-nrf-run / qemu-esp-run something to type into:
# `kernel uptime`, `kernel threads`, `help`.
CONFIG_SHELL=y
CONFIG_KERNEL_SHELL=y
```

## src/main.c
```c
/*
 * Emulator smoke test. test/emu-smoke.sh greps for the banner and for
 * "tick 3": the ticks come from k_sleep, so they prove the timer, the
 * scheduler and the UART all keep running -- not just that the first printk
 * got out.
 */
#include <zephyr/kernel.h>

int main(void)
{
	printk("emu-smoke: boot ok on %s\n", CONFIG_BOARD_TARGET);

	for (int n = 1;; n++) {
		k_sleep(K_SECONDS(1));
		printk("emu-smoke: tick %d\n", n);
	}

	return 0;
}
```
